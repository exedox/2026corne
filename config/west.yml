## config/west.yml
```yaml
manifest:
  remotes:
      # zmk official
    - name: zmkfirmware
      url-base: https://github.com/zmkfirmware
    - name: exedox                         #new entry
      url-base: https://github.com/exedox  #new entry
  projects:
    - name: zmk
      remote: zmkfirmware
      revision: v0.2
      import: app/west.yml
    - name: nice-view-zynogre                 #new entry
      remote: exedox                       #new entry
      revision: main                      #new entry
  self:
    path: config
```
